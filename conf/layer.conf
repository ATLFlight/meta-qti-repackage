## conf/layer.conf
```bitbake
# We have a conf and classes directory, add to BBPATH
BBPATH .= ":${LAYERDIR}"

# We have recipes-* directories, add to BBFILES
BBFILES += "${LAYERDIR}/recipes-*/*/*.bb \
	${LAYERDIR}/recipes-*/*/*.bbappend"

BBFILE_COLLECTIONS += "qti-repackage"
BBFILE_PATTERN_qti-repackage = "^${LAYERDIR}/"
BBFILE_PRIORITY_qti-repackage = "6"
```
